## fw/3rd-components/protothreads/Kconfig
```kconfig
menu "Protothreads Configuration"

    config PT_USE_SEMAPHORE
        bool "Enable Protothreads semaphore"
        default y

endmenu
```

## fw/3rd-components/smf/Kconfig
```kconfig
menu "SMF(State Machine Framework) Configuration"

    config SMF_ANCESTOR_SUPPORT
        bool "States to have 1 or more ancestors"
        default y
        help
            If y, then the state machine framework includes ancestor state support

    config SMF_INITIAL_TRANSITION
        depends on SMF_ANCESTOR_SUPPORT
        bool "Support initial transitions for ancestor states"
        default y
        help
            If y, then each state can have an initial transition to a sub-state

endmenu
```

## fw/components/borneo-core/Kconfig
```kconfig
menu "Borneo Core"
    menu "Board Information"

        config BORNEO_PRODUCT_ID
            string "Borneo Product ID"
            default "$BORNEO_PRODUCT_ID"

        config BORNEO_BOARD_ID
            string "Borneo board ID"
            default "$BORNEO_BOARD"

        config BORNEO_BOARD_NAME
            string "Borneo board name"

        config BORNEO_DEVICE_NAME_DEFAULT
            string "Borneo device's default name"

        config BORNEO_DEVICE_COMPATIBLE
            string "Borneo device compatible string"

        config BORNEO_DEVICE_CATEGORY
            string "Borneo Device Category"

        config BORNEO_HW_VER
            string "Borneo hardware version"

        config BORNEO_MANUF_DEFAULT
            string "Borneo manufacturer default value"
            default "BST"

        choice
            prompt "Select product mode"

            config BORNEO_PRODUCT_MODE_STANDALONE
                bool "Standalone Controller"

            config BORNEO_PRODUCT_MODE_FULL
                bool "Proprietary Product"

            config BORNEO_PRODUCT_MODE_OEM
                bool "OEM / Custom"
        endchoice

    endmenu

    menu "ADC settings"
        config BORNEO_ADC_ENABLED
            bool "ADC enabled"
            default y
    endmenu


    menu "LED Indicator"
        config BORNEO_INDICATOR_ENABLED
            bool "Indicator enabled"
            default y

        choice
            prompt "Select indicator type"

            config BORNEO_INDICATOR_GPIO_ENABLED
                bool "Simple GPIO LED"
                default y
                depends on BORNEO_INDICATOR_ENABLED

            config BORNEO_INDICATOR_ADDRESSABLE_ENABLED
                bool "Addressable LED"
                depends on BORNEO_INDICATOR_ENABLED
        endchoice

        config BORNEO_INDICATOR_GPIO
            int "Indicator pin"
            depends on BORNEO_INDICATOR_ENABLED

        config BORNEO_INDICATOR_ADDRESSABLE_BRIGHTNESS
            hex "Indicator brightness (0x01-0xFF)"
            range 0x1 0xFF
            default 0x3C
            depends on BORNEO_INDICATOR_ADDRESSABLE_ENABLED
    endmenu

    menu "OTA"
        config BORNEO_OTA_FIRMWARE_UPGRADE_URL
            string "OTA firmware upgrade URL"
    endmenu

    menu "Power Supply Voltage Measurement"
        config BORNEO_MEAS_VOLTAGE_SUPPORT
            bool "Power supply voltage measurement enabled"
            default n

        config BORNEO_MEAS_VOLTAGE_ADC_CHANNEL
            int "Power supply voltage ADC channel"
            depends on BORNEO_MEAS_VOLTAGE_SUPPORT

        config BORNEO_MEAS_VOLTAGE_FACTOR
            int "Power supply ADC voltage attenuation coefficient in μV"
            depends on BORNEO_MEAS_VOLTAGE_SUPPORT
            default 15242
    endmenu


endmenu
```

## fw/components/drvfx/Kconfig
```kconfig
menu "Drvfx Configuration"
    menu "Drivers"

        menu "RTC (Real-Time Clock)"
            choice
                prompt "RTC device"
                default DRIVER_RTC_NONE

                config DRIVER_RTC_NONE
                    bool "No RTC"

                config DRIVER_RTC_IDF
                    bool "SoC internal RTC"

                config DRIVER_RTC_DS1302
                    bool "DS1302"

                config DRIVER_RTC_PCF8563
                    bool "PCF8563"
            endchoice

            config DRIVER_RTC_DS1302_CE_GPIO
                int "DS1302 CE GPIO number"
                depends on DRIVER_RTC_DS1302

            config DRIVER_RTC_DS1302_IO_GPIO
                int "DS1302 I/O GPIO number"
                depends on DRIVER_RTC_DS1302

            config DRIVER_RTC_DS1302_SCLK_GPIO
                int "DS1302 SCLK GPIO number"
                depends on DRIVER_RTC_DS1302

            config DRIVER_RTC_DS1302_RST_GPIO
                int "DS1302 RST GPIO number"
                depends on DRIVER_RTC_DS1302

            config DRIVER_RTC_PCF8563_ADDR
                hex "The I2C address of PCF8563"
                default 0x51
                depends on DRIVER_RTC_PCF8563

            config DRIVER_RTC_PCF8563_I2C_PORT
                int "PCF8563 I2C port"
                depends on DRIVER_RTC_PCF8563

            config DRIVER_RTC_PCF8563_SDA_GPIO
                int "PCF8563 I2C SDA GPIO number"
                depends on DRIVER_RTC_PCF8563

            config DRIVER_RTC_PCF8563_SCL_GPIO
                int "PCF8563 I2C SCL GPIO number"
                depends on DRIVER_RTC_PCF8563

        endmenu

    endmenu


endmenu
```

## fw/doser/main/Kconfig.projbuild
```kconfig
menu "Borneo LyFi"

    menu "Pump channels"

        config PUMP_CH0_ENABLED
            bool "Pump channel 0 enabled"
            default n

        config PUMP_CH1_ENABLED
            bool "Pump channel 1 enabled"
            default n

        config PUMP_CH2_ENABLED
            bool "Pump channel 2 enabled"
            default n

        config PUMP_CH3_ENABLED
            bool "Pump channel 3 enabled"
            default n

        config PUMP_CH4_ENABLED
            bool "Pump channel 4 enabled"
            default n

        config PUMP_CH5_ENABLED
            bool "Pump channel 5 enabled"
            default n

        config PUMP_CHANNEL_COUNT
            int
            default 6 if PUMP_CH5_ENABLED
            default 5 if PUMP_CH4_ENABLED
            default 4 if PUMP_CH3_ENABLED
            default 3 if PUMP_CH2_ENABLED
            default 2 if PUMP_CH1_ENABLED
            default 1 if PUMP_CH0_ENABLED
            default 0
            depends on PUMP_CH0_ENABLED || PUMP_CH1_ENABLED || PUMP_ENABLED || PUMP_CH3_ENABLED || PUMP_CH4_ENABLED || PUMP_CH5_ENABLED

        config PUMP_CH0_GPIO
            int "GPIO for pump channel 0"
            depends on PUMP_CH0_ENABLED

        config PUMP_CH1_GPIO
            int "GPIO for pump channel 1"
            depends on PUMP_CH1_ENABLED

        config PUMP_CH2_GPIO
            int "GPIO for pump channel 2"
            depends on PUMP_CH2_ENABLED

        config PUMP_CH3_GPIO
            int "GPIO for pump channel 3"
            depends on PUMP_CH3_ENABLED

        config PUMP_CH4_GPIO
            int "GPIO for pump channel 4"
            depends on PUMP_CH4_ENABLED

        config PUMP_CH5_GPIO
            int "GPIO for pump channel 5"
            depends on PUMP_CH5_ENABLED

    endmenu

        config DOSER_MASTER_BUTTON_ENABLED
            bool "The master button of doser enabled"
            default y

        config DOSER_MASTER_BUTTON_GPIO
            int "The GPIO number of the master button"
            depends on DOSER_MASTER_BUTTON_ENABLED

endmenu
```
